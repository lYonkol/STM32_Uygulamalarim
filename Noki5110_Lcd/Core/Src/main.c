/* USER CODE BEGIN Header */
/**
  ******************************************************************************
  * @file           : main.c
  * @brief          : Main program body
  ******************************************************************************
  * @attention
  *
  * Copyright (c) 2025 STMicroelectronics.
  * All rights reserved.
  *
  * This software is licensed under terms that can be found in the LICENSE file
  * in the root directory of this software component.
  * If no LICENSE file comes with this software, it is provided AS-IS.
  *
  ******************************************************************************
  */
/* USER CODE END Header */
/* Includes ------------------------------------------------------------------*/
#include "main.h"
#include "math.h"
#include <stdio.h>
/* Private includes ----------------------------------------------------------*/
/* USER CODE BEGIN Includes */

/* USER CODE END Includes */

/* Private typedef -----------------------------------------------------------*/
/* USER CODE BEGIN PTD */

/* USER CODE END PTD */

/* Private define ------------------------------------------------------------*/
/* USER CODE BEGIN PD */
#define LCD_RST_PORT GPIOA
#define LCD_RST_PIN  GPIO_PIN_0
#define LCD_CE_PORT  GPIOA
#define LCD_CE_PIN   GPIO_PIN_1
#define LCD_DC_PORT  GPIOA
#define LCD_DC_PIN   GPIO_PIN_2

#define SHT31_ADDR (0x44 << 1)
/* USER CODE END PD */

/* Private macro -------------------------------------------------------------*/
/* USER CODE BEGIN PM */

/* USER CODE END PM */

/* Private variables ---------------------------------------------------------*/
I2C_HandleTypeDef hi2c1;

SPI_HandleTypeDef hspi1;

/* USER CODE BEGIN PV */
const uint8_t ASCII[][5] = {
		0x00, 0x00, 0x00, 0x00, 0x00,  // 0x00 (nul)
			0x3E, 0x5B, 0x4F, 0x5B, 0x3E,  // 0x01 (soh)
			0x3E, 0x6B, 0x4F, 0x6B, 0x3E,  // 0x02 (stx)
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			0x00, 0x00, 0x00, 0x00, 0x00   // 0xFF
};
const uint8_t icon_temp[8] = {
    0b00000000,
    0b00000000,
    0b01111100,
    0b01000100,
    0b01000100,
    0b01111100,
    0b00111000,
    0b00000000
};

const uint8_t icon_humidity[8] = {
    0b00010000,
    0b00111000,
    0b01111100,
    0b01111100,
    0b01111100,
    0b00111000,
    0b00010000,
    0b00000000
};




float temperature = 0.0f;
float humidity = 0.0f;
char buffer[32];
/* USER CODE END PV */

/* Private function prototypes -----------------------------------------------*/
void SystemClock_Config(void);
static void MX_GPIO_Init(void);
static void MX_SPI1_Init(void);
static void MX_I2C1_Init(void);
/* USER CODE BEGIN PFP */

/* USER CODE END PFP */

/* Private user code ---------------------------------------------------------*/
/* USER CODE BEGIN 0 */
void LCD_SendCommand(uint8_t cmd) {
    HAL_GPIO_WritePin(LCD_DC_PORT, LCD_DC_PIN, GPIO_PIN_RESET); // DC = 0
    HAL_GPIO_WritePin(LCD_CE_PORT, LCD_CE_PIN, GPIO_PIN_RESET); // CE = 0

    HAL_SPI_Transmit(&hspi1, &cmd, 1, HAL_MAX_DELAY);

    HAL_GPIO_WritePin(LCD_CE_PORT, LCD_CE_PIN, GPIO_PIN_SET);   // CE = 1
}

void LCD_SendData(uint8_t data) {
    HAL_GPIO_WritePin(LCD_DC_PORT, LCD_DC_PIN, GPIO_PIN_SET);   // DC = 1
    HAL_GPIO_WritePin(LCD_CE_PORT, LCD_CE_PIN, GPIO_PIN_RESET); // CE = 0

    HAL_SPI_Transmit(&hspi1, &data, 1, HAL_MAX_DELAY);

    HAL_GPIO_WritePin(LCD_CE_PORT, LCD_CE_PIN, GPIO_PIN_SET);   // CE = 1
}

void LCD_Clear(void) {
    // LCD'nin RAM'ini sıfırla (tüm piksel verisi 0x00)
    for (uint16_t i = 0; i < 504; i++) { // 84 x 48 / 8 = 504 byte
        LCD_SendData(0x00);
    }

    // İmleci başa al (optional)
    LCD_SendCommand(0x80); // X = 0
    LCD_SendCommand(0x40); // Y = 0
}

void LCD_Init(void) {
    // Reset işlemi
    HAL_GPIO_WritePin(LCD_RST_PORT, LCD_RST_PIN, GPIO_PIN_RESET);
    HAL_Delay(10);
    HAL_GPIO_WritePin(LCD_RST_PORT, LCD_RST_PIN, GPIO_PIN_SET);
    LCD_SendCommand(0x21); // Extended instruction set
    LCD_SendCommand(0xB1); // Vop = kontrast
    LCD_SendCommand(0x04); // Temperature Coefficient
    LCD_SendCommand(0x14); // Bias mode 1:48
    LCD_SendCommand(0x20); // Temel komut setine dön
    LCD_SendCommand(0x0C); // Normal display


    LCD_Clear();
}

void LCD_WriteChar(char character) {
    uint8_t index = (uint8_t)character;  // ASCII dizini direkt karakterin kendisi

    for (int i = 0; i < 5; i++) {
        LCD_SendData(ASCII[index][i]);
    }

    LCD_SendData(0x00); // boşluk
}

void LCD_WriteString(const char* str) {
    while (*str) {
        LCD_WriteChar(*str++);
    }
}
void LCD_SetCursor(uint8_t x, uint8_t y) {
    // x: 0 - 83, y: 0 - 5
    LCD_SendCommand(0x80 | x); // X adresi: 0x80 + x
    LCD_SendCommand(0x40 | y); // Y adresi: 0x40 + y
}

void LCD_DrawBitmap(const uint8_t* bitmap, uint8_t width, uint8_t height, uint8_t x, uint8_t y) {
    uint8_t rows = height / 8;

    for (uint8_t row = 0; row < rows; row++) {
        LCD_SetCursor(x, y + row);
        for (uint8_t col = 0; col < width; col++) {
            LCD_SendData(bitmap[row * width + col]);
        }
    }
}

void LCD_DrawIcon(const uint8_t* icon, uint8_t x, uint8_t y) {
    LCD_SetCursor(x, y);
    for (int i = 0; i < 8; i++) {
        LCD_SendData(icon[i]);
    }
}

void SHT31_ReadTempHum(void) {
    uint8_t cmd[2] = {0x2C, 0x06}; // ölçüm başlatma komutu
    uint8_t data[6]; // sıcaklık ve nem 6 byte

    HAL_I2C_Master_Transmit(&hi2c1, SHT31_ADDR, cmd, 2, HAL_MAX_DELAY);
    HAL_Delay(15); // ölçüm süresi için bekle (datasheet öneriyor)
    HAL_I2C_Master_Receive(&hi2c1, SHT31_ADDR, data, 6, HAL_MAX_DELAY);

    // Veri çözümleme
    uint16_t temp_raw = (data[0] << 8) | data[1];
    uint16_t hum_raw  = (data[3] << 8) | data[4];

    // Datasheet formülü
    temperature = -45 + 175 * ((float)temp_raw / 65535.0f);
    humidity = 100 * ((float)hum_raw / 65535.0f);
}

void LCD_DisplayTempHum(void) {
    int t_int = (int)temperature;
    int t_dec = (int)((temperature - t_int) * 10);
    int h_int = (int)humidity;
    int h_dec = (int)((humidity - h_int) * 10);

    LCD_Clear();

    // 🌡️ Sıcaklık
    LCD_DrawIcon(icon_temp, 0, 0);
    LCD_SetCursor(10, 0);
    sprintf(buffer, "%d.%dC", t_int, t_dec);
    LCD_WriteString(buffer);

    // 💧 Nem
    LCD_DrawIcon(icon_humidity, 0, 1);
    LCD_SetCursor(10, 1);
    sprintf(buffer, "%d.%d%%", h_int, h_dec);
    LCD_WriteString(buffer);
}
/* USER CODE END 0 */

/**
  * @brief  The application entry point.
  * @retval int
  */
int main(void)
{

  /* USER CODE BEGIN 1 */

  /* USER CODE END 1 */

  /* MCU Configuration--------------------------------------------------------*/

  /* Reset of all peripherals, Initializes the Flash interface and the Systick. */
  HAL_Init();

  /* USER CODE BEGIN Init */

  /* USER CODE END Init */

  /* Configure the system clock */
  SystemClock_Config();

  /* USER CODE BEGIN SysInit */

  /* USER CODE END SysInit */

  /* Initialize all configured peripherals */
  MX_GPIO_Init();
  MX_SPI1_Init();
  MX_I2C1_Init();
  /* USER CODE BEGIN 2 */
  LCD_Init();

  /* USER CODE END 2 */

  /* Infinite loop */
  /* USER CODE BEGIN WHILE */
  while (1)
  {
    /* USER CODE END WHILE */

    /* USER CODE BEGIN 3 */
      SHT31_ReadTempHum();
      LCD_DisplayTempHum();
      HAL_Delay(1000);
  }
  /* USER CODE END 3 */
}

/**
  * @brief System Clock Configuration
  * @retval None
  */
void SystemClock_Config(void)
{
  RCC_OscInitTypeDef RCC_OscInitStruct = {0};
  RCC_ClkInitTypeDef RCC_ClkInitStruct = {0};

  /** Configure the main internal regulator output voltage
  */
  __HAL_RCC_PWR_CLK_ENABLE();
  __HAL_PWR_VOLTAGESCALING_CONFIG(PWR_REGULATOR_VOLTAGE_SCALE1);

  /** Initializes the RCC Oscillators according to the specified parameters
  * in the RCC_OscInitTypeDef structure.
  */
  RCC_OscInitStruct.OscillatorType = RCC_OSCILLATORTYPE_HSI;
  RCC_OscInitStruct.HSIState = RCC_HSI_ON;
  RCC_OscInitStruct.HSICalibrationValue = RCC_HSICALIBRATION_DEFAULT;
  RCC_OscInitStruct.PLL.PLLState = RCC_PLL_ON;
  RCC_OscInitStruct.PLL.PLLSource = RCC_PLLSOURCE_HSI;
  RCC_OscInitStruct.PLL.PLLM = 8;
  RCC_OscInitStruct.PLL.PLLN = 168;
  RCC_OscInitStruct.PLL.PLLP = RCC_PLLP_DIV2;
  RCC_OscInitStruct.PLL.PLLQ = 4;
  if (HAL_RCC_OscConfig(&RCC_OscInitStruct) != HAL_OK)
  {
    Error_Handler();
  }

  /** Initializes the CPU, AHB and APB buses clocks
  */
  RCC_ClkInitStruct.ClockType = RCC_CLOCKTYPE_HCLK|RCC_CLOCKTYPE_SYSCLK
                              |RCC_CLOCKTYPE_PCLK1|RCC_CLOCKTYPE_PCLK2;
  RCC_ClkInitStruct.SYSCLKSource = RCC_SYSCLKSOURCE_PLLCLK;
  RCC_ClkInitStruct.AHBCLKDivider = RCC_SYSCLK_DIV1;
  RCC_ClkInitStruct.APB1CLKDivider = RCC_HCLK_DIV4;
  RCC_ClkInitStruct.APB2CLKDivider = RCC_HCLK_DIV2;

  if (HAL_RCC_ClockConfig(&RCC_ClkInitStruct, FLASH_LATENCY_5) != HAL_OK)
  {
    Error_Handler();
  }
}

/**
  * @brief I2C1 Initialization Function
  * @param None
  * @retval None
  */
static void MX_I2C1_Init(void)
{

  /* USER CODE BEGIN I2C1_Init 0 */

  /* USER CODE END I2C1_Init 0 */

  /* USER CODE BEGIN I2C1_Init 1 */

  /* USER CODE END I2C1_Init 1 */
  hi2c1.Instance = I2C1;
  hi2c1.Init.ClockSpeed = 100000;
  hi2c1.Init.DutyCycle = I2C_DUTYCYCLE_2;
  hi2c1.Init.OwnAddress1 = 0;
  hi2c1.Init.AddressingMode = I2C_ADDRESSINGMODE_7BIT;
  hi2c1.Init.DualAddressMode = I2C_DUALADDRESS_DISABLE;
  hi2c1.Init.OwnAddress2 = 0;
  hi2c1.Init.GeneralCallMode = I2C_GENERALCALL_DISABLE;
  hi2c1.Init.NoStretchMode = I2C_NOSTRETCH_DISABLE;
  if (HAL_I2C_Init(&hi2c1) != HAL_OK)
  {
    Error_Handler();
  }
  /* USER CODE BEGIN I2C1_Init 2 */

  /* USER CODE END I2C1_Init 2 */

}

/**
  * @brief SPI1 Initialization Function
  * @param None
  * @retval None
  */
static void MX_SPI1_Init(void)
{

  /* USER CODE BEGIN SPI1_Init 0 */

  /* USER CODE END SPI1_Init 0 */

  /* USER CODE BEGIN SPI1_Init 1 */

  /* USER CODE END SPI1_Init 1 */
  /* SPI1 parameter configuration*/
  hspi1.Instance = SPI1;
  hspi1.Init.Mode = SPI_MODE_MASTER;
  hspi1.Init.Direction = SPI_DIRECTION_2LINES;
  hspi1.Init.DataSize = SPI_DATASIZE_8BIT;
  hspi1.Init.CLKPolarity = SPI_POLARITY_LOW;
  hspi1.Init.CLKPhase = SPI_PHASE_1EDGE;
  hspi1.Init.NSS = SPI_NSS_SOFT;
  hspi1.Init.BaudRatePrescaler = SPI_BAUDRATEPRESCALER_64;
  hspi1.Init.FirstBit = SPI_FIRSTBIT_MSB;
  hspi1.Init.TIMode = SPI_TIMODE_DISABLE;
  hspi1.Init.CRCCalculation = SPI_CRCCALCULATION_DISABLE;
  hspi1.Init.CRCPolynomial = 10;
  if (HAL_SPI_Init(&hspi1) != HAL_OK)
  {
    Error_Handler();
  }
  /* USER CODE BEGIN SPI1_Init 2 */

  /* USER CODE END SPI1_Init 2 */

}

/**
  * @brief GPIO Initialization Function
  * @param None
  * @retval None
  */
static void MX_GPIO_Init(void)
{
  GPIO_InitTypeDef GPIO_InitStruct = {0};
/* USER CODE BEGIN MX_GPIO_Init_1 */
/* USER CODE END MX_GPIO_Init_1 */

  /* GPIO Ports Clock Enable */
  __HAL_RCC_GPIOH_CLK_ENABLE();
  __HAL_RCC_GPIOA_CLK_ENABLE();
  __HAL_RCC_GPIOB_CLK_ENABLE();

  /*Configure GPIO pin Output Level */
  HAL_GPIO_WritePin(GPIOA, RST_Pin|CE_Pin|DC_Pin, GPIO_PIN_RESET);

  /*Configure GPIO pins : RST_Pin CE_Pin DC_Pin */
  GPIO_InitStruct.Pin = RST_Pin|CE_Pin|DC_Pin;
  GPIO_InitStruct.Mode = GPIO_MODE_OUTPUT_PP;
  GPIO_InitStruct.Pull = GPIO_NOPULL;
  GPIO_InitStruct.Speed = GPIO_SPEED_FREQ_LOW;
  HAL_GPIO_Init(GPIOA, &GPIO_InitStruct);

/* USER CODE BEGIN MX_GPIO_Init_2 */
/* USER CODE END MX_GPIO_Init_2 */
}

/* USER CODE BEGIN 4 */

/* USER CODE END 4 */

/**
  * @brief  This function is executed in case of error occurrence.
  * @retval None
  */
void Error_Handler(void)
{
  /* USER CODE BEGIN Error_Handler_Debug */
  /* User can add his own implementation to report the HAL error return state */
  __disable_irq();
  while (1)
  {
  }
  /* USER CODE END Error_Handler_Debug */
}

#ifdef  USE_FULL_ASSERT
/**
  * @brief  Reports the name of the source file and the source line number
  *         where the assert_param error has occurred.
  * @param  file: pointer to the source file name
  * @param  line: assert_param error line source number
  * @retval None
  */
void assert_failed(uint8_t *file, uint32_t line)
{
  /* USER CODE BEGIN 6 */
  /* User can add his own implementation to report the file name and line number,
     ex: printf("Wrong parameters value: file %s on line %d\r\n", file, line) */
  /* USER CODE END 6 */
}
#endif /* USE_FULL_ASSERT */
